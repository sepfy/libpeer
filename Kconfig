## Kconfig
```kconfig
menu "libpeer"
    config LIBPEER_SCTP_MTU
        int "SCTP MTU"
        default 1200
        help
            The SCTP MTU.
    config LIBPEER_MTU
        int "MTU"
        default 1300
        help
            The MTU.
    config LIBPEER_VIDEO_BUFFER_SIZE_MTUS
        int "Video Buffer Size in MTUs"
        default 7
        help
            The Video RB Data MTUs.
    config LIBPEER_AUDIO_BUFFER_SIZE_MTUS
        int "Audio Buffer Size in MTUs"
        default 7
        help
            The Audio RB Data MTUs.
    config LIBPEER_DATA_BUFFER_SIZE_MTUS
        int "Data Buffer Size in MTUs"
        default 86
        help
            The Data RB Data MTUs.
    config LIBPEER_SDP_BUFFER_SIZE
        int "SDP Buffer Size"
        default 8096
        help
            The SDP Buffer Size.
    config LIBPEER_MQTT_BUFFER_SIZE
        int "MQTT Buffer Size"
        default 8096
        help
            The MQTT Buffer Size.
    config LIBPEER_AUDIO_LATENCY_MS
        int "Audio Latency (ms)"
        default 20
        help
            The Audio Latency in milliseconds.
    config LIBPEER_KEEPALIVE_CONNCHECK
        int "Keepalive Conncheck interval"
        default 0
        help
            The Keepalive Conncheck.
    choice LIBPEER_LOG_LEVEL
        prompt "Log Level"
        default LIBPEER_LOG_LEVEL_INFO
        help
            The Log Level.
        config LIBPEER_LOG_LEVEL_DEBUG
            bool "Debug"
        config LIBPEER_LOG_LEVEL_INFO
            bool "Info"
        config LIBPEER_LOG_LEVEL_WARN
            bool "Warn"
        config LIBPEER_LOG_LEVEL_ERROR
            bool "Error"
    endchoice
endmenu
```

## examples/esp32/main/Kconfig.projbuild
```kconfig
menu "Peer Example Configuration"

    choice ESP32_CAMERA_MODEL
        prompt "Camera model"
        default ESP32_EYE
        help
            Select the camera model to use.
        config ESP32_EYE
            bool "ESP32-EYE"
        config ESP32S3_EYE
            bool "ESP32S3-EYE"
        config ESP32_M5STACK_CAMERA_B
            bool "M5STACK-CAMERA-B"
        config ESP32S3_XIAO_SENSE
            bool "ESP32S3-XIAO-SENSE"
    endchoice

    config SIGNALING_URL
        string "Signaling URL"
        default "https://libpeer.com/public/test"
        help
            Enter the URL of the Peer library to use.
    config SIGNALING_TOKEN
        string "Signaling Token"
        default ""
        help
            Enter the token of the Peer library to use.
endmenu
```
